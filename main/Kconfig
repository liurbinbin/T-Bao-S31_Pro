## main/Kconfig
```kconfig
menu "Xiaozhi Chat Application"
    config APP_MEMORY_DIAGNOSTICS_INTERVAL_SECONDS
        int "内存与任务栈周期采样间隔（秒，0 为关闭）"
        range 0 3600
        default 60
        help
            复用现有任务采样，不创建新任务，也不暂停全系统扫描任务栈。
            记录内部堆、内部 DMA 堆和 PSRAM 的剩余量、低水位及最大连续块。
            已接入的任务自行记录最小剩余栈，单位为字节。
            设置为 0 仅关闭周期采样，保留启动、页面与 AI 生命周期检查点。

    menuconfig TBAO_CAMERA_SUPPORT
        bool "Enable T-Bao S31 camera"
        default y
        help
            Enable the OV2640/OV3660 PARLIO JPEG camera used by T-Bao S31.

    config TBAO_CAMERA_OV3660
        bool "Use OV3660 camera power profile"
        depends on TBAO_CAMERA_SUPPORT
        default n
        help
            Select this when the fitted camera module is OV3660. The runtime
            probe rejects OV2640 when this profile is selected.

    config TBAO_CAMERA_OV2640_CORE_1V3
        bool "Use 1.3V OV2640 DVDD profile"
        depends on TBAO_CAMERA_SUPPORT && !TBAO_CAMERA_OV3660
        default n
        help
            Select the optional 1.3V OV2640 core-voltage profile. The default
            OV2640 profile is approximately 1.2V.

    choice XIAOZHI_CHAT_APP_TRANSPORT
        prompt "Preferred transport when both MQTT and WebSocket are supported"
        default XIAOZHI_CHAT_APP_TRANSPORT_AUTO
        help
            When the server provides both MQTT and WebSocket, this option selects which to use.
            If "Auto (prefer MQTT)" is selected, MQTT is used when both are available.

        config XIAOZHI_CHAT_APP_TRANSPORT_AUTO
            bool "Auto (prefer MQTT)"
        config XIAOZHI_CHAT_APP_TRANSPORT_MQTT
            bool "MQTT"
        config XIAOZHI_CHAT_APP_TRANSPORT_WEBSOCKET
            bool "WebSocket"
    endchoice
endmenu
```
